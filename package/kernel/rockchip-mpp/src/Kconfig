## package/kernel/rockchip-mpp/src/Kconfig
```kconfig
# SPDX-License-Identifier: GPL-2.0-only

menu "Rockchip media platform drivers"

source "drivers/video/rockchip/rga/Kconfig"
source "drivers/media/platform/rockchip/fec/Kconfig"
source "drivers/media/platform/rockchip/avsp/Kconfig"

endmenu
```

## package/kernel/rockchip-mpp/src/rga/Kconfig
```kconfig
config ROCKCHIP_RGA
	tristate "Rockchip Raster 2d Graphic Acceleration Unit"
	depends on ARCH_ROCKCHIP || COMPILE_TEST
	help
	  This is a driver for Rockchip SOC RGA 2d graphics accelerator.
	  Rockchip RGA is a separate 2D raster graphic acceleration unit.
	  It accelerates 2D graphics operations, such as point/line drawing,
	  image scaling, rotation, BitBLT, alpha blending and image blur/sharpness.

	  To compile this driver as a module choose m here.
```
